## CMakeLists.txt
```
cmake_minimum_required(VERSION 3.20.0)

if (EXISTS "${CMAKE_CURRENT_SOURCE_DIR}/credentials.conf")
    list(APPEND EXTRA_CONF_FILE "${CMAKE_CURRENT_SOURCE_DIR}/credentials.conf")
endif()

find_package(Zephyr REQUIRED HINTS $ENV{ZEPHYR_BASE})
project(esp32_industrial_sensor_observability)

add_subdirectory(src/net ${CMAKE_CURRENT_BINARY_DIR}/src/net)

target_sources(app PRIVATE
        src/main.c
        src/sensor_node.c
)
```

## Kconfig
```
rsource "src/net/Kconfig"

source "Kconfig.zephyr"
```

## sysbuild.conf
```
SB_CONFIG_BOOTLOADER_MCUBOOT=y
SB_CONFIG_MCUBOOT_MODE_OVERWRITE_ONLY=y
```

## west.yml
```
manifest:
  projects:
    # Zephyr RTOS - used by all ESP32 boards:
    #   esp32c3_devkitc, esp32c6_devkitc_esp32c6_hpcore, esp32s3_devkitc_esp32s3_procpu
    - name: zephyr
      url: https://github.com/zephyrproject-rtos/zephyr
      revision: v4.4.0
      clone-depth: 1
      import:
        path-prefix: external
        name-allowlist:
          - hal_espressif
          - mbedtls
          - mcuboot
          - zcbor
          - mldsa-native
          - tf-psa-crypto

    - name: spotflow-device-sdk
      url: https://github.com/spotflow-io/device-sdk
      revision: main
      path: external/modules/lib/spotflow
```

## prj.conf
```kconfig
# ============================================
# Spotflow SDK
# ============================================
CONFIG_SPOTFLOW=y
CONFIG_SPOTFLOW_MODULE_DEFAULT_LOG_LEVEL=4

# ============================================
# Logging
# ============================================
CONFIG_LOG=y

# Zephyr log ring buffer (stage 1). Default 1024 B overflows during the early
# boot burst before the log thread gets a timeslice, causing dropped messages.
CONFIG_LOG_BUFFER_SIZE=2048

CONFIG_LOG_RUNTIME_FILTERING=y
CONFIG_REQUIRES_FLOAT_PRINTF=y

# Show function names in log output, helps trace crashes to the exact call site.
CONFIG_LOG_FUNC_NAME_PREFIX_INF=y
CONFIG_LOG_FUNC_NAME_PREFIX_WRN=y
CONFIG_LOG_FUNC_NAME_PREFIX_ERR=y

# Spotflow backend queue (stage 2), independent of CONFIG_LOG_BUFFER_SIZE.
# QUEUE_SIZE: messages buffered during offline periods.
# LOG_BUFFER_SIZE: per-message staging buffer; size to your longest log line.
CONFIG_SPOTFLOW_LOG_BACKEND_QUEUE_SIZE=16
CONFIG_SPOTFLOW_LOG_BUFFER_SIZE=256
CONFIG_SPOTFLOW_CBOR_LOG_MAX_LEN=512
CONFIG_HEAP_MEM_POOL_ADD_SIZE_SPOTFLOW_LOGGING=3072

# ============================================
# Metrics
# ============================================
CONFIG_SPOTFLOW_METRICS=y
CONFIG_SPOTFLOW_METRICS_SYSTEM=y
CONFIG_SPOTFLOW_METRICS_SYSTEM_RESET_CAUSE=y
CONFIG_SPOTFLOW_METRICS_HEARTBEAT=y
CONFIG_SPOTFLOW_METRICS_HEARTBEAT_INTERVAL=60

# ============================================
# Coredumps
# ============================================
CONFIG_SPOTFLOW_COREDUMPS=y
CONFIG_GPIO=y
CONFIG_DEBUG_COREDUMP_MEMORY_DUMP_LINKER_RAM=y
CONFIG_DEBUG_COREDUMP_THREADS_METADATA=y

# ============================================
# Networking
# ============================================
CONFIG_NETWORKING=y
CONFIG_NET_MGMT=y
CONFIG_NET_MGMT_EVENT=y
CONFIG_NET_MGMT_EVENT_INFO=y
CONFIG_NET_CONFIG_AUTO_INIT=n
CONFIG_NET_CONNECTION_MANAGER=y
CONFIG_NET_DHCPV4=y
CONFIG_NET_IPV4=y
CONFIG_NET_IPV6=n
CONFIG_NET_TCP=y
CONFIG_NET_UDP=y

# ============================================
# Flash / Settings (required by Spotflow for state persistence)
# ============================================
CONFIG_FLASH=y
CONFIG_FLASH_MAP=y
CONFIG_NVS=y
CONFIG_SETTINGS=y
CONFIG_SETTINGS_NVS=y

# ============================================
# Stack / Heap
# ============================================
CONFIG_MAIN_STACK_SIZE=4096
CONFIG_HEAP_MEM_POOL_ADD_SIZE_SPOTFLOW_METRICS=6144

# Ensures connection works on boards without hardware RNG.
# Remove this option for production use.
CONFIG_MBEDTLS_PSA_CRYPTO_LEGACY_RNG=y
```

## credentials-sample.conf
```kconfig
# Copy this file to credentials.conf and fill in your values.
CONFIG_NET_WIFI_SSID=""
CONFIG_NET_WIFI_PASSWORD=""
CONFIG_SPOTFLOW_DEVICE_ID="esp32-industrial-sensor-001"
CONFIG_SPOTFLOW_INGEST_KEY=""
```

## boards/esp32c3_devkitc.conf
```kconfig
# Automatic Wi-Fi reconnection
CONFIG_ESP32_WIFI_STA_RECONNECT=y

# ESP32-C3 DevKitC has limited flash - use minimal coredump format
CONFIG_DEBUG_COREDUMP_MEMORY_DUMP_MIN=y

# Reduce coredump memory footprint to fit within the smaller partition
CONFIG_HEAP_MEM_POOL_ADD_SIZE_SPOTFLOW_COREDUMPS=8192
CONFIG_SPOTFLOW_COREDUMPS_CHUNK_SIZE=1024
CONFIG_SPOTFLOW_COREDUMPS_BACKEND_QUEUE_SIZE=7
```

## boards/esp32c6_devkitc_esp32c6_hpcore.conf
```kconfig
# Automatic Wi-Fi reconnection is not enabled by default on ESP32-C6
CONFIG_ESP32_WIFI_STA_RECONNECT=y

# Thread metadata is not supported on this board
CONFIG_DEBUG_COREDUMP_THREADS_METADATA=n
```

## boards/esp32s3_devkitc_esp32s3_procpu.conf
```kconfig
# WiFi Config
CONFIG_WIFI_ESP32=y
CONFIG_ESP32_WIFI_STA_AUTO_DHCPV4=y
CONFIG_ESP32_WIFI_STA_RECONNECT=y
CONFIG_NET_L2_ETHERNET=y
CONFIG_ESPTOOLPY_FLASHSIZE_32MB=y
```

## boards/esp32_8M.dtsi
```dts
/* Redefining coredump partition to be 1MB at the end of 8MB flash. */

/delete-node/ &coredump_partition;

&flash0 {
	partitions {
		compatible = "fixed-partitions";
		#address-cells = <1>;
		#size-cells = <1>;

		/* New coredump partition: 1MB at the end of 8MB flash */
		coredump_partition: partition@700000 {
			label = "coredump-partition";
			reg = <0x700000 DT_SIZE_M(1)>;
		};
	};
};
```

## boards/esp32c3_devkitc.overlay
```dts
&wifi {
	status = "okay";
};

/* Remove the default scratch and coredump partitions, then define a
 * dedicated 128 KB coredump partition at the top of the 4 MB flash.
 * Based on partitions_0x0_default_4M.dtsi from Zephyr. */
/delete-node/ &scratch_partition;
/delete-node/ &coredump_partition;

&flash0 {
	partitions {
		compatible = "fixed-partitions";
		#address-cells = <1>;
		#size-cells = <1>;

		/* 128 KB coredump partition */
		coredump_partition: partition@3e0000 {
			label = "coredump-partition";
			reg = <0x3e0000 DT_SIZE_K(128)>;
		};
	};
};
```

## boards/esp32c6_devkitc_esp32c6_hpcore.overlay
```dts
#include "esp32_8M.dtsi"

&wifi {
	status = "okay";
};
```

## boards/esp32s3_devkitc_esp32s3_procpu.overlay
```dts
#include "esp32_8M.dtsi"

&flash0 {
	/* The connected ESP32-S3 board exposes 32 MB flash, not the upstream N8 default. */
	reg = <0x0 DT_SIZE_M(32)>;
};

&wifi {
	status = "okay";
};
```

## src/main.c
```c
#include <errno.h>

#include <zephyr/drivers/gpio.h>
#include <zephyr/kernel.h>
#include <zephyr/logging/log.h>

#include "net.h"
#include "sensor_node.h"

LOG_MODULE_REGISTER(esp32_sensor_main, LOG_LEVEL_INF);

#define SW0_NODE DT_ALIAS(sw0)
#if !DT_NODE_HAS_STATUS_OKAY(SW0_NODE)
#error "Unsupported board: sw0 devicetree alias is not defined"
#endif

static const struct gpio_dt_spec button = GPIO_DT_SPEC_GET_OR(SW0_NODE, gpios, { 0 });
static struct gpio_callback button_cb_data;

static void button_pressed(const struct device *dev, struct gpio_callback *cb, uint32_t pins)
{
	ARG_UNUSED(dev);
	ARG_UNUSED(cb);
	ARG_UNUSED(pins);

	LOG_INF("User button pressed. Arming reproducible crash path.");
	sensor_node_trigger_repro_crash();
}

static int prepare_button(void)
{
	int ret;

	if (!gpio_is_ready_dt(&button)) {
		LOG_ERR("Error: button device %s is not ready", button.port->name);
		return -EINVAL;
	}

	ret = gpio_pin_configure_dt(&button, GPIO_INPUT);
	if (ret != 0) {
		LOG_ERR("Error %d: failed to configure %s pin %d", ret, button.port->name,
			button.pin);
		return ret;
	}

	ret = gpio_pin_interrupt_configure_dt(&button, GPIO_INT_EDGE_TO_ACTIVE);
	if (ret != 0) {
		LOG_ERR("Error %d: failed to configure interrupt on %s pin %d", ret,
			button.port->name, button.pin);
		return ret;
	}

	gpio_init_callback(&button_cb_data, button_pressed, BIT(button.pin));
	gpio_add_callback(button.port, &button_cb_data);

	return 0;
}

int main(void)
{
	LOG_INF("ESP32 industrial sensor node example starting");
	LOG_INF("This demo combines ESP32 remote logging, ESP32 device monitoring, and crash reports.");

	int rc = prepare_button();
	if (rc != 0) {
		LOG_ERR("Failed to prepare button: %d", rc);
		return rc;
	}

	/* Allow the network interface driver to finish initialization. */
	k_sleep(K_SECONDS(1));
	spotflow_sample_net_init();

	rc = sensor_node_init();
	if (rc < 0) {
		LOG_ERR("Failed to initialize industrial sensor node: %d", rc);
		return rc;
	}

	while (true) {
		sensor_node_step();
		k_sleep(K_SECONDS(2));
	}

	return 0;
}
```

## src/sensor_node.c
```c
#include "sensor_node.h"

#include <string.h>

#include <zephyr/kernel.h>
#include <zephyr/logging/log.h>
#include <zephyr/random/random.h>

#include "metrics/spotflow_metrics_backend.h"

LOG_MODULE_REGISTER(sensor_node, LOG_LEVEL_INF);

#define SENSOR_CHANNELS 3
#define SENSOR_READING_MIN_C (-20.0f)
#define SENSOR_READING_MAX_C (110.0f)

static struct spotflow_metric_float *g_sensor_cycle_duration_metric;
static struct spotflow_metric_int *g_sensor_read_failures_metric;
static struct spotflow_metric_int *g_uplink_retry_metric;
static struct spotflow_metric_float *g_sensor_data_age_metric;

struct telemetry_frame {
	uint8_t channel_count;
	uint16_t sample_period_ms;
	float readings[SENSOR_CHANNELS];
};

static struct telemetry_frame g_frame = {
	.channel_count = SENSOR_CHANNELS,
	.sample_period_ms = 250,
	.readings = { 24.5f, 24.8f, 25.0f },
};

static int g_loop_count;
static int g_sensor_backlog_ms;
static bool g_repro_mode;

static float rand_range(float min, float max)
{
	return min + ((float)(sys_rand32_get() % 1000) / 1000.0f) * (max - min);
}

static int register_metrics(void)
{
	int rc;

	rc = spotflow_register_metric_float(
		"sensor_cycle_duration_ms",
		SPOTFLOW_AGG_INTERVAL_1MIN,
		&g_sensor_cycle_duration_metric);
	if (rc < 0) {
		return rc;
	}

	rc = spotflow_register_metric_int(
		"sensor_read_failures",
		SPOTFLOW_AGG_INTERVAL_NONE,
		&g_sensor_read_failures_metric);
	if (rc < 0) {
		return rc;
	}

	rc = spotflow_register_metric_int(
		"uplink_retry_count",
		SPOTFLOW_AGG_INTERVAL_NONE,
		&g_uplink_retry_metric);
	if (rc < 0) {
		return rc;
	}

	rc = spotflow_register_metric_float(
		"sensor_data_age_ms",
		SPOTFLOW_AGG_INTERVAL_NONE,
		&g_sensor_data_age_metric);
	if (rc < 0) {
		return rc;
	}

	return 0;
}

static void report_sensor_cycle(float duration_ms)
{
	int rc = spotflow_report_metric_float(g_sensor_cycle_duration_metric, duration_ms);
	if (rc < 0) {
		LOG_ERR("Failed to report sensor_cycle_duration_ms: %d", rc);
	}
}

static void report_sensor_data_age(float age_ms)
{
	int rc = spotflow_report_metric_float(g_sensor_data_age_metric, age_ms);
	if (rc < 0) {
		LOG_ERR("Failed to report sensor_data_age_ms: %d", rc);
	}
}

static void report_event_metric(struct spotflow_metric_int *metric, const char *metric_name)
{
	int rc = spotflow_report_event(metric);
	if (rc < 0) {
		LOG_ERR("Failed to report %s: %d", metric_name, rc);
	}
}

static void update_sensor_frame(void)
{
	for (int i = 0; i < SENSOR_CHANNELS; ++i) {
		g_frame.readings[i] = rand_range(SENSOR_READING_MIN_C, SENSOR_READING_MAX_C);
	}
}

static float decode_auxiliary_channel(const struct telemetry_frame *frame)
{
	if (frame->channel_count <= SENSOR_CHANNELS) {
		return 0.0f;
	}

	/*
	 * This intentionally models the kind of parser bug that shows up in the field:
	 * the code trusts a corrupted channel count, decides an auxiliary channel must
	 * exist, and dereferences a pointer that was never validated.
	 */
	const float *auxiliary = NULL;

	LOG_ERR("Malformed telemetry frame detected: channel_count=%u exceeds supported=%u",
		frame->channel_count, SENSOR_CHANNELS);

	return *auxiliary;
}

static void process_sensor_frame(const struct telemetry_frame *frame)
{
	float sum = 0.0f;
	uint8_t samples_to_sum = frame->channel_count;

	if (samples_to_sum > SENSOR_CHANNELS) {
		samples_to_sum = SENSOR_CHANNELS;
	}

	for (int i = 0; i < samples_to_sum; ++i) {
		sum += frame->readings[i];
	}

	sum += decode_auxiliary_channel(frame);

	float average = sum / frame->channel_count;
	LOG_INF("Uploaded sensor batch: channels=%u avg=%.2fC age=%d ms",
		frame->channel_count, (double)average, g_sensor_backlog_ms);
}

static void maybe_inject_failures(void)
{
	if ((g_loop_count % 7) == 0) {
		g_sensor_backlog_ms += 350;
		LOG_WRN("Sensor FIFO backlog grew to %d ms after repeated uplink retries", g_sensor_backlog_ms);
		report_event_metric(g_uplink_retry_metric, "uplink_retry_count");
	}

	if ((g_loop_count % 11) == 0) {
		LOG_WRN("CRC mismatch on Modbus frame from remote probe head");
		report_event_metric(g_sensor_read_failures_metric, "sensor_read_failures");
	}

	if (g_sensor_backlog_ms > 1500) {
		LOG_ERR("Sensor data age exceeded safe threshold: %d ms", g_sensor_backlog_ms);
	}
}

int sensor_node_init(void)
{
	g_loop_count = 0;
	g_sensor_backlog_ms = 150;
	g_repro_mode = false;

	int rc = register_metrics();
	if (rc < 0) {
		LOG_ERR("Failed to initialize sensor node metrics: %d", rc);
		return rc;
	}

	LOG_INF("Industrial sensor node ready. Press the user button to reproduce the field crash path.");
	return 0;
}

void sensor_node_step(void)
{
	++g_loop_count;

	update_sensor_frame();

	float cycle_duration_ms = rand_range(32.0f, 160.0f) + (float)g_sensor_backlog_ms * 0.05f;
	report_sensor_cycle(cycle_duration_ms);
	report_sensor_data_age((float)g_sensor_backlog_ms);

	maybe_inject_failures();

	if ((g_loop_count % 5) == 0 && g_sensor_backlog_ms > 100) {
		g_sensor_backlog_ms -= 90;
	}

	if (g_repro_mode && g_loop_count >= 3) {
		LOG_ERR("Reproducing field crash: parser trusts corrupted channel_count=%u",
			g_frame.channel_count);
		process_sensor_frame(&g_frame);
		return;
	}

	process_sensor_frame(&g_frame);
}

void sensor_node_trigger_repro_crash(void)
{
	LOG_WRN("Crash repro armed: forcing malformed sensor frame after a short delay");
	g_repro_mode = true;
	g_loop_count = 0;
	g_sensor_backlog_ms = 2100;
	g_frame.channel_count = 7;
	memset(g_frame.readings, 0, sizeof(g_frame.readings));
	for (int i = 0; i < SENSOR_CHANNELS; ++i) {
		g_frame.readings[i] = rand_range(48.0f, 62.0f);
	}
}
```

## src/sensor_node.h
```c
#ifndef ESP32_INDUSTRIAL_SENSOR_NODE_H
#define ESP32_INDUSTRIAL_SENSOR_NODE_H

int sensor_node_init(void);

void sensor_node_step(void);

void sensor_node_trigger_repro_crash(void);

#endif /* ESP32_INDUSTRIAL_SENSOR_NODE_H */
```
