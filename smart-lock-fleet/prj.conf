## CMakeLists.txt
```
cmake_minimum_required(VERSION 3.20.0)

if (EXISTS "${CMAKE_CURRENT_SOURCE_DIR}/credentials.conf")
    list(APPEND EXTRA_CONF_FILE "${CMAKE_CURRENT_SOURCE_DIR}/credentials.conf")
endif()

find_package(Zephyr REQUIRED HINTS $ENV{ZEPHYR_BASE})
project(smart_lock_fleet)

add_subdirectory(src/net ${CMAKE_CURRENT_BINARY_DIR}/src/net)

target_sources(app PRIVATE
        src/main.c
        src/lock.c
        src/battery.c
)
```

## Kconfig
```
rsource "net-common/Kconfig"

source "Kconfig.zephyr"
```

## west.yml
```
manifest:
  projects:
    # Zephyr RTOS - used by all non-NCS boards:
    #   cy8cproto_062_4343w (Infineon), esp32c3_devkitm, esp32c6_devkitc_esp32c6_hpcore,
    #   esp32s3_devkitc_esp32s3_procpu (Espressif), frdm_rw612 (NXP), rpi_pico_rp2040_w
    - name: zephyr
      url: https://github.com/zephyrproject-rtos/zephyr
      revision: v4.3.0
      clone-depth: 1
      import:
        path-prefix: external
        name-allowlist:
          - cmsis_6          # Infineon, NXP, RPi Pico W
          - hal_espressif    # Espressif (ESP32-C3, ESP32-C6, ESP32-S3)
          - hal_infineon     # Infineon (CY8CPROTO), RPi Pico W (CYW43)
          - hal_nxp          # NXP (FRDM-RW612)
          - hal_rpi_pico     # Raspberry Pi Pico W
          - mbedtls          # all boards
          - mcuboot          # all boards
          - zcbor            # all boards

    - name: spotflow-device-sdk
      url: https://github.com/spotflow-io/device-sdk
      revision: main
      path: external/modules/lib/spotflow
```

## prj.conf
```kconfig
# ============================================
# Spotflow SDK
# ============================================
CONFIG_SPOTFLOW=y
CONFIG_SPOTFLOW_MODULE_DEFAULT_LOG_LEVEL=3

# ============================================
# Metrics Configuration
# ============================================
CONFIG_SPOTFLOW_METRICS=y
CONFIG_SPOTFLOW_METRICS_SYSTEM=y

# ============================================
# Logging
# ============================================
CONFIG_LOG=y
CONFIG_REQUIRES_FLOAT_PRINTF=y

# ============================================
# Networking
# ============================================
CONFIG_NETWORKING=y
CONFIG_NET_MGMT=y
CONFIG_NET_MGMT_EVENT=y
CONFIG_NET_MGMT_EVENT_INFO=y
CONFIG_NET_CONFIG_AUTO_INIT=n
CONFIG_NET_CONNECTION_MANAGER=y
CONFIG_NET_DHCPV4=y
CONFIG_NET_IPV4=y
CONFIG_NET_IPV6=n
CONFIG_NET_TCP=y
CONFIG_NET_UDP=y

# Increase main stack size
CONFIG_MAIN_STACK_SIZE=4096
```

## credentials-sample.conf
```kconfig
# Copy this file to credentials.conf and fill in the values
CONFIG_NET_WIFI_SSID=""
CONFIG_NET_WIFI_PASSWORD=""
CONFIG_SPOTFLOW_DEVICE_ID=""
CONFIG_SPOTFLOW_INGEST_KEY=""
```

## boards/cy8cproto_062_4343w.conf
```kconfig
# CY8CPROTO-062-4343W (Infineon AIROC Wi-Fi)
# No board-specific overrides required beyond the defaults supplied by Kconfig.
```

## boards/esp32c3_devkitc.conf
```kconfig
# Automatic Wi-Fi reconnection isn't enabled by default on ESP32-C3
CONFIG_ESP32_WIFI_STA_RECONNECT=y
```

## boards/esp32c6_devkitc_esp32c6_hpcore.conf
```kconfig
# Automatic Wi-Fi reconnection isn't enabled by default on ESP32-C6
CONFIG_ESP32_WIFI_STA_RECONNECT=y
```

## boards/esp32s3_devkitc_esp32s3_procpu.conf
```kconfig
# Automatic Wi-Fi reconnection isn't enabled by default on ESP32-S3
CONFIG_ESP32_WIFI_STA_RECONNECT=y
```

## boards/frdm_rw612.conf
```kconfig
# These configs are automatically enabled for FRDM-RW612 board from kconfig:
#   WIFI_NXP
#   NXP_WIFI_TX_RX_ZERO_COPY
#   NET_IF_MAX_IPV4_COUNT=2

# Fix buffer size for RW612 on Zephyr 4.1.0+
CONFIG_NET_BUF_DATA_SIZE=256

CONFIG_NXP_WIFI_SOFTAP_SUPPORT=n
```

## boards/esp32c3_devkitc.overlay
```dts
// Empty overlay - no devicetree overrides needed for ESP32-C3 DevKitC
// Wi-Fi is enabled via Kconfig (esp32c3_devkitc.conf)
```

## boards/esp32c3_devkitm.overlay
```dts
// Empty overlay - no devicetree overrides needed for ESP32-C3 DevKitM
// Wi-Fi is enabled via Kconfig (esp32c3_devkitm.conf)
```

## boards/esp32c6_devkitc_esp32c6_hpcore.overlay
```dts
// Empty overlay - no devicetree overrides needed for ESP32-C6 DevKitC
// Wi-Fi is enabled via Kconfig (esp32c6_devkitc_esp32c6_hpcore.conf)
```

## boards/esp32s3_devkitc_esp32s3_procpu.overlay
```dts
// Empty overlay - no devicetree overrides needed for ESP32-S3 DevKitC
// Wi-Fi is enabled via Kconfig (esp32s3_devkitc_esp32s3_procpu.conf)
```

## src/main.c
```c
#include <zephyr/kernel.h>
#include <zephyr/logging/log.h>

#include "net.h"
#include "lock.h"

LOG_MODULE_REGISTER(smart_lock_main, LOG_LEVEL_INF);

int main(void)
{
	LOG_INF("Smart Lock Fleet - Spotflow Metrics Sample");

	/* Allow the network interface driver to finish initialization */
	k_sleep(K_SECONDS(1));

	/* Connect to Wi-Fi or start DHCP on Ethernet, depending on board config */
	spotflow_sample_net_init();

	/* Register lock-related metrics (operation duration, door opened, auth failure) */
	int rc = init_lock_metrics();
	if (rc < 0) {
		LOG_ERR("Failed to initialize lock metrics: %d", rc);
		return -1;
	}

	LOG_INF("Starting lock operation simulation...");

	/*
	 * Main loop: simulate lock/unlock operations every 3 seconds.
	 *
	 * In a real device this loop would be replaced by interrupt-driven callbacks
	 * from NFC, keypad, or Bluetooth subsystems. The metric reporting calls
	 * (on_lock_operation_complete, on_door_opened, on_auth_failure) are identical
	 * whether called from a simulation loop or real hardware event handlers.
	 */
	while (true) {
		simulate_lock_operation();
		k_sleep(K_SECONDS(3));
	}

	return 0;
}
```

## src/battery.c
```c
/*
 * Smart Lock Fleet - Battery Monitor Module
 *
 * Registers and reports one custom Spotflow metric:
 *
 *   battery_level_percent  (float, no aggregation)
 *     No labels. Sampled every 5 minutes and sent immediately as a raw value.
 *
 * The metric is registered inside the thread entry (following the SDK pattern
 * used for the temperature metric in the official metrics sample). The thread
 * starts automatically via K_THREAD_DEFINE and runs independently.
 *
 * In a real device, read_battery_percent() would perform an ADC read and
 * convert the raw voltage to a percentage using the battery discharge curve.
 * Here we simulate a slowly draining battery starting from a random level.
 */

#include <zephyr/kernel.h>
#include <zephyr/logging/log.h>
#include <zephyr/random/random.h>

#include "metrics/spotflow_metrics_backend.h"

LOG_MODULE_REGISTER(smart_lock_battery, LOG_LEVEL_INF);

#define BATTERY_THREAD_STACK_SIZE 2048
#define BATTERY_THREAD_PRIORITY   5

/* Report battery level every 5 minutes */
#define BATTERY_REPORT_INTERVAL_MS (5 * 60 * 1000)

static struct spotflow_metric_float *g_battery_metric;

/**
 * @brief Simulate reading the battery percentage.
 *
 * Starts at a random level between 60% and 100%, then drains by a small
 * random amount each call to mimic real-world battery behaviour.
 *
 * @return Simulated battery level in percent (0.0 – 100.0).
 */
static float read_battery_percent(void)
{
	static float level = -1.0f;

	if (level < 0.0f) {
		/* Initialize to a random starting level on first call */
		level = 60.0f + ((float)(sys_rand32_get() % 4000) / 100.0f);
	}

	/* Drain between 0.05% and 0.25% per 5-minute sample */
	float drain = 0.05f + ((float)(sys_rand32_get() % 20) / 100.0f);
	level -= drain;

	if (level < 0.0f) {
		level = 0.0f;
	}

	return level;
}

static void battery_thread_entry(void)
{
	LOG_INF("Battery monitor thread started");

	/*
	 * Register the metric inside the thread, matching the SDK pattern
	 * (see temperature_thread_entry in the official metrics sample).
	 */
	int rc = spotflow_register_metric_float(
		"battery_level_percent",
		SPOTFLOW_AGG_INTERVAL_NONE,
		&g_battery_metric);
	if (rc < 0) {
		LOG_ERR("Failed to register battery_level_percent: %d", rc);
		return;
	}
	LOG_INF("Registered metric: battery_level_percent (float, NONE)");

	while (true) {
		float level = read_battery_percent();

		rc = spotflow_report_metric_float(g_battery_metric, level);
		if (rc < 0) {
			LOG_ERR("Failed to report battery_level_percent: %d", rc);
		} else {
			LOG_DBG("Battery level: %.1f%%", (double)level);
		}

		k_sleep(K_MSEC(BATTERY_REPORT_INTERVAL_MS));
	}
}

K_THREAD_DEFINE(battery_thread, BATTERY_THREAD_STACK_SIZE,
		battery_thread_entry, NULL, NULL, NULL,
		BATTERY_THREAD_PRIORITY, 0, 0);
```

## src/battery.h
```c
#ifndef SMART_LOCK_BATTERY_H
#define SMART_LOCK_BATTERY_H

/**
 * @brief Start the battery monitor thread.
 *
 * The thread registers the battery_level_percent metric and reports a
 * simulated battery reading every 5 minutes. Call this once from main()
 * after the network is up.
 *
 * The metric registration happens inside the thread (same pattern as the
 * Spotflow SDK temperature example), so this function returns immediately
 * and the thread runs independently.
 */
void init_battery_monitor(void);

#endif /* SMART_LOCK_BATTERY_H */
```

## src/lock.c
```c
/*
 * Smart Lock Fleet - Lock Metrics Module
 *
 * Registers and reports three custom Spotflow metrics:
 *
 *   lock_operation_duration_ms  (float, 1-minute aggregation)
 *     Labels: "operation" (lock | unlock), "method" (nfc | keypad | bluetooth)
 *     Reports the time in milliseconds each lock/unlock operation takes.
 *     The SDK aggregates all reports within a 1-minute window and transmits
 *     sum/count/min/max in a single MQTT message.
 *
 *   door_opened  (int, no aggregation)
 *     No labels. Each call to on_door_opened() sends one event immediately.
 *
 *   auth_failure  (int, no aggregation)
 *     Label: "method" (nfc | keypad | bluetooth)
 *     Each failed authentication attempt is sent immediately as a labeled event.
 */

#include "lock.h"

#include <zephyr/kernel.h>
#include <zephyr/logging/log.h>
#include <zephyr/random/random.h>

#include "metrics/spotflow_metrics_backend.h"

LOG_MODULE_REGISTER(smart_lock, LOG_LEVEL_INF);

/* Metric handles */
static struct spotflow_metric_float *g_op_duration_metric;
static struct spotflow_metric_int   *g_door_opened_metric;
static struct spotflow_metric_int   *g_auth_failure_metric;

/* Possible label values */
static const char *const OPERATIONS[] = { "lock", "unlock" };
static const char *const METHODS[]    = { "nfc", "keypad", "bluetooth" };

/* Simulated duration ranges per method (milliseconds) */
static const float METHOD_DURATION_BASE[]  = { 80.0f,  40.0f,  120.0f }; /* nfc, keypad, bt */
static const float METHOD_DURATION_RANGE[] = { 200.0f, 80.0f,  350.0f };

int init_lock_metrics(void)
{
	int rc;

	/*
	 * lock_operation_duration_ms: float, 1-minute aggregation.
	 * max_timeseries = 6: 2 operations (lock/unlock) x 3 methods = 6 label combinations.
	 * max_labels = 2: "operation" and "method".
	 */
	rc = spotflow_register_metric_float_with_labels(
		"lock_operation_duration_ms",
		SPOTFLOW_AGG_INTERVAL_1MIN,
		6,  /* max_timeseries */
		2,  /* max_labels */
		&g_op_duration_metric);
	if (rc < 0) {
		LOG_ERR("Failed to register lock_operation_duration_ms: %d", rc);
		return rc;
	}
	LOG_INF("Registered metric: lock_operation_duration_ms (float, labeled, 1MIN)");

	/*
	 * door_opened: int, no aggregation.
	 * Every door open event is transmitted immediately as a discrete data point.
	 */
	rc = spotflow_register_metric_int(
		"door_opened",
		SPOTFLOW_AGG_INTERVAL_NONE,
		&g_door_opened_metric);
	if (rc < 0) {
		LOG_ERR("Failed to register door_opened: %d", rc);
		return rc;
	}
	LOG_INF("Registered metric: door_opened (int, NONE)");

	/*
	 * auth_failure: int, no aggregation, labeled by method.
	 * max_timeseries = 3: one series per method (nfc, keypad, bluetooth).
	 * max_labels = 1: "method".
	 */
	rc = spotflow_register_metric_int_with_labels(
		"auth_failure",
		SPOTFLOW_AGG_INTERVAL_NONE,
		3,  /* max_timeseries */
		1,  /* max_labels */
		&g_auth_failure_metric);
	if (rc < 0) {
		LOG_ERR("Failed to register auth_failure: %d", rc);
		return rc;
	}
	LOG_INF("Registered metric: auth_failure (int, labeled, NONE)");

	return 0;
}

/**
 * @brief Report a successful lock/unlock operation with duration and labels.
 */
static void on_lock_operation_complete(const char *operation,
				       const char *method,
				       float duration_ms)
{
	struct spotflow_label labels[] = {
		{ .key = "operation", .value = operation },
		{ .key = "method",    .value = method    },
	};

	int rc = spotflow_report_metric_float_with_labels(
		g_op_duration_metric, duration_ms, labels, 2);
	if (rc < 0) {
		LOG_ERR("Failed to report lock_operation_duration_ms: %d", rc);
	} else {
		LOG_DBG("Reported %s via %s: %.1f ms", operation, method, (double)duration_ms);
	}
}

/**
 * @brief Report a door opened event.
 */
static void on_door_opened(void)
{
	int rc = spotflow_report_event(g_door_opened_metric);
	if (rc < 0) {
		LOG_ERR("Failed to report door_opened: %d", rc);
	} else {
		LOG_DBG("Reported door_opened event");
	}
}

/**
 * @brief Report an authentication failure for a given method.
 */
static void on_auth_failure(const char *method)
{
	struct spotflow_label labels[] = {
		{ .key = "method", .value = method },
	};

	int rc = spotflow_report_event_with_labels(g_auth_failure_metric, labels, 1);
	if (rc < 0) {
		LOG_ERR("Failed to report auth_failure: %d", rc);
	} else {
		LOG_WRN("Auth failure via %s", method);
	}
}

void simulate_lock_operation(void)
{
	/* Pick a random operation and method */
	uint32_t rnd         = sys_rand32_get();
	const char *operation = OPERATIONS[rnd % 2];
	uint32_t method_idx  = (rnd >> 2) % 3;
	const char *method   = METHODS[method_idx];

	/*
	 * Simulate an authentication failure with ~15% probability.
	 * In a real device this would come from the actual auth subsystem.
	 */
	if ((sys_rand32_get() % 100) < 15) {
		on_auth_failure(method);
		/* The user tries again and succeeds; continue to report the operation below. */
	}

	/* Simulate operation duration: base + random fraction of range */
	float base  = METHOD_DURATION_BASE[method_idx];
	float range = METHOD_DURATION_RANGE[method_idx];
	float duration_ms = base + ((float)(sys_rand32_get() % 1000) / 1000.0f) * range;

	on_lock_operation_complete(operation, method, duration_ms);

	/* A successful unlock operation opens the door */
	if (strcmp(operation, "unlock") == 0) {
		on_door_opened();
	}

	LOG_INF("Simulated %s via %s (%.1f ms)", operation, method, (double)duration_ms);
}
```

## src/lock.h
```c
#ifndef SMART_LOCK_LOCK_H
#define SMART_LOCK_LOCK_H

/**
 * @brief Register all lock-related custom metrics with the Spotflow SDK.
 *
 * Must be called once from main() after the network is up, before any
 * lock operations are simulated or reported.
 *
 * Registers:
 *   - lock_operation_duration_ms  (float, 1MIN, labels: operation, method)
 *   - door_opened                 (int,   NONE, no labels)
 *   - auth_failure                (int,   NONE, label: method)
 *
 * @return 0 on success, negative errno on failure.
 */
int init_lock_metrics(void);

/**
 * @brief Simulate one lock or unlock operation and report metrics.
 *
 * Randomly picks an operation (lock/unlock) and a method (nfc/keypad/bluetooth),
 * simulates an operation duration, and reports it via Spotflow. Occasionally
 * injects a simulated authentication failure before a successful operation.
 *
 * Also fires a door_opened event when the lock operation succeeds.
 */
void simulate_lock_operation(void);

#endif /* SMART_LOCK_LOCK_H */
```
