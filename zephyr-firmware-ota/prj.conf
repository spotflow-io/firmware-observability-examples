## CMakeLists.txt
```
cmake_minimum_required(VERSION 3.20.0)

if (EXISTS "${CMAKE_CURRENT_SOURCE_DIR}/credentials.conf")
    list(APPEND EXTRA_CONF_FILE "${CMAKE_CURRENT_SOURCE_DIR}/credentials.conf")
endif()

find_package(Zephyr REQUIRED HINTS $ENV{ZEPHYR_BASE})
project(zephyr_firmware_ota)

add_subdirectory(src/net ${CMAKE_CURRENT_BINARY_DIR}/src/net)

target_sources(app PRIVATE
        src/main.c
)
```

## west.yml
```
manifest:
  projects:
    # Zephyr RTOS - FRDM-RW612 (NXP RW612)
    - name: zephyr
      url: https://github.com/zephyrproject-rtos/zephyr
      revision: v4.4.0
      clone-depth: 1
      import:
        path-prefix: external
        name-allowlist:
          - cmsis_6
          - hal_nxp
          - mbedtls
          - mcuboot
          - zcbor
          - mldsa-native
          - tf-psa-crypto

    - name: spotflow-device-sdk
      url: https://github.com/spotflow-io/device-sdk
      revision: main
      path: external/modules/lib/spotflow
```

## prj.conf
```kconfig
# Spotflow SDK
CONFIG_SPOTFLOW=y
CONFIG_SPOTFLOW_MODULE_DEFAULT_LOG_LEVEL=4

# OTA updates
CONFIG_SPOTFLOW_OTA=y
CONFIG_SPOTFLOW_OTA_AUTO_HANDLE_MAIN_FIRMWARE=y
# Optional: raise only the OTA update log verbosity, independent of the other
# Spotflow modules. Defaults to CONFIG_SPOTFLOW_MODULE_DEFAULT_LOG_LEVEL.
# CONFIG_SPOTFLOW_OTA_LOG_LEVEL=4

# Logging
CONFIG_LOG=y
CONFIG_LOG_PROCESS_THREAD_STACK_SIZE=2048
CONFIG_LOG_BUFFER_SIZE=2048
CONFIG_LOG_RUNTIME_FILTERING=y
CONFIG_REQUIRES_FLOAT_PRINTF=y
CONFIG_LOG_FUNC_NAME_PREFIX_INF=y
CONFIG_LOG_FUNC_NAME_PREFIX_WRN=y
CONFIG_LOG_FUNC_NAME_PREFIX_ERR=y
CONFIG_SPOTFLOW_LOG_BACKEND_QUEUE_SIZE=16
CONFIG_SPOTFLOW_LOG_BUFFER_SIZE=256
CONFIG_SPOTFLOW_CBOR_LOG_MAX_LEN=512
CONFIG_HEAP_MEM_POOL_ADD_SIZE_SPOTFLOW_LOGGING=3072

# Metrics
CONFIG_SPOTFLOW_METRICS=y
CONFIG_SPOTFLOW_METRICS_SYSTEM=y
CONFIG_SPOTFLOW_METRICS_SYSTEM_RESET_CAUSE=y
CONFIG_SPOTFLOW_METRICS_HEARTBEAT=y
CONFIG_SPOTFLOW_METRICS_HEARTBEAT_INTERVAL=60

# Networking
CONFIG_NETWORKING=y
CONFIG_NET_MGMT=y
CONFIG_NET_MGMT_EVENT=y
CONFIG_NET_MGMT_EVENT_INFO=y
CONFIG_NET_CONFIG_AUTO_INIT=n
CONFIG_NET_CONNECTION_MANAGER=y
CONFIG_NET_DHCPV4=y
CONFIG_NET_IPV4=y
CONFIG_NET_IPV6=n
CONFIG_NET_TCP=y
CONFIG_NET_UDP=y

# Flash / Settings — required by the automatic OTA update handling.
CONFIG_FLASH=y
CONFIG_FLASH_MAP=y
CONFIG_STREAM_FLASH=y
CONFIG_STREAM_FLASH=y
CONFIG_NVS=y
CONFIG_SETTINGS=y
CONFIG_SETTINGS_NVS=y

# Stack / Heap
CONFIG_MAIN_STACK_SIZE=4096
CONFIG_HEAP_MEM_POOL_ADD_SIZE_SPOTFLOW_METRICS=6144
```

## credentials-sample.conf
```kconfig
# Copy this file to credentials.conf and fill in your values.
# credentials.conf is excluded from version control by .gitignore.
CONFIG_NET_WIFI_SSID=""
CONFIG_NET_WIFI_PASSWORD=""
CONFIG_SPOTFLOW_DEVICE_ID="nxp-frdm-rw612-ota-001"
CONFIG_SPOTFLOW_INGEST_KEY=""
```

## boards/frdm_rw612.conf
```kconfig
# Fix buffer size for RW612 on Zephyr 4.1.0+
CONFIG_NET_BUF_DATA_SIZE=256

CONFIG_NXP_WIFI_SOFTAP_SUPPORT=n
```

## src/main.c
```c
#include <zephyr/kernel.h>
#include <zephyr/logging/log.h>
#include <zephyr/random/random.h>

#include <spotflow/ota.h>

#include "metrics/spotflow_metrics_backend.h"
#include "net.h"

LOG_MODULE_REGISTER(main, LOG_LEVEL_INF);

/*
 * Firmware version — bump to "2.0.0" when building the update image.
 * The calibration offset corrects a systematic measurement error identified
 * after the initial field deployment.
 */
#define APP_VERSION             "1.0.0"
#define TEMP_CALIBRATION_OFFSET 0.0f /* v2.0: change to 1.5f */

static struct spotflow_metric_float *g_temperature_metric;

/* ---- OTA phase helpers ---- */

static const char *ota_phase_name(enum spotflow_ota_phase phase)
{
	switch (phase) {
	case SPOTFLOW_OTA_PHASE_NOT_RUNNING:
		return "NOT_RUNNING";
	case SPOTFLOW_OTA_PHASE_PENDING_DOWNLOAD:
		return "PENDING_DOWNLOAD";
	case SPOTFLOW_OTA_PHASE_DOWNLOADING:
		return "DOWNLOADING";
	case SPOTFLOW_OTA_PHASE_PENDING_UPGRADE:
		return "PENDING_UPGRADE";
	case SPOTFLOW_OTA_PHASE_PENDING_REBOOT:
		return "PENDING_REBOOT";
	case SPOTFLOW_OTA_PHASE_UNCONFIRMED:
		return "UNCONFIRMED";
	default:
		return "UNKNOWN";
	}
}

/*
 * confirm_unconfirmed_main_firmware
 *
 * Called once at boot.  If the device started in MCUboot test mode
 * (phase == UNCONFIRMED), run any self-tests here and then confirm the image.
 * If the image is not confirmed before the next reboot, MCUboot rolls back to
 * the previous firmware automatically.
 */
static void confirm_unconfirmed_main_firmware(void)
{
	struct spotflow_ota_main_firmware_state state;
	int ret = spotflow_get_main_firmware_update_state(&state);

	if (ret < 0) {
		LOG_ERR("Failed to query OTA state: %d", ret);
		return;
	}

	if (state.phase != SPOTFLOW_OTA_PHASE_UNCONFIRMED) {
		LOG_INF("OTA phase: %s", ota_phase_name(state.phase));
		return;
	}

	LOG_INF("New firmware booted (phase=%s) — confirming image",
		ota_phase_name(state.phase));

	/*
	 * Insert application-specific self-tests here.
	 * If any test fails, call sys_reboot() instead of confirming.
	 * MCUboot will revert to the previous firmware on the next boot.
	 */

	ret = spotflow_confirm_main_firmware_image(&state);
	if (ret < 0) {
		LOG_ERR("Failed to confirm firmware image: %d", ret);
		return;
	}

	LOG_INF("Firmware v%s confirmed — result will be reported to Spotflow", APP_VERSION);
}

/* ---- OTA callbacks ---- */

/*
 * The SDK calls this on the OTA worker thread whenever the automatic main
 * firmware update moves to a new phase.  Use it to log progress, update an
 * LED, or pause the update when the device is busy.
 */
void spotflow_on_main_firmware_update_progressed(
	const struct spotflow_ota_main_firmware_state *state)
{
	if (state == NULL) {
		return;
	}

	LOG_INF("OTA progress: phase=%s paused=%d result=%d",
		ota_phase_name(state->phase), state->is_paused, state->result);
}

void spotflow_on_update_canceled(void)
{
	LOG_INF("OTA update canceled by the cloud");
}

/* ---- Sensor simulation ---- */

static float read_temperature(void)
{
	/* Simulate a sensor producing values in the 28–34 °C range. */
	float raw = 28.0f + ((float)(sys_rand32_get() % 600)) / 100.0f;
	return raw + TEMP_CALIBRATION_OFFSET;
}

/* ---- Entry point ---- */

int main(void)
{
	LOG_INF("Temperature sensor node v%s starting", APP_VERSION);

	confirm_unconfirmed_main_firmware();

	int ret = spotflow_register_metric_float(
		"temperature_celsius", SPOTFLOW_AGG_INTERVAL_1MIN, &g_temperature_metric);
	if (ret < 0) {
		LOG_ERR("Failed to register temperature_celsius metric: %d", ret);
	}

	/* Allow the network interface driver to finish initialization. */
	k_sleep(K_SECONDS(1));
	spotflow_sample_net_init();

	LOG_INF("Sensor loop running — ready to receive OTA updates");

	while (true) {
		float temp = read_temperature();
		LOG_INF("Temperature: %.1f C", (double)temp);
		(void)spotflow_report_metric_float(g_temperature_metric, temp);
		k_sleep(K_SECONDS(2));
	}

	return 0;
}
```
