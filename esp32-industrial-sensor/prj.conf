## CMakeLists.txt
```
cmake_minimum_required(VERSION 3.20.0)

if (EXISTS "${CMAKE_CURRENT_SOURCE_DIR}/credentials.conf")
    list(APPEND EXTRA_CONF_FILE "${CMAKE_CURRENT_SOURCE_DIR}/credentials.conf")
endif()

find_package(Zephyr REQUIRED HINTS $ENV{ZEPHYR_BASE})
project(esp32_industrial_sensor)

add_subdirectory(src/net ${CMAKE_CURRENT_BINARY_DIR}/src/net)

target_sources(app PRIVATE
        src/main.c
        src/sensor.c
)
```

## west.yml
```
manifest:
  projects:
    # Zephyr RTOS - used by all ESP32 boards:
    #   esp32c3_devkitc, esp32c6_devkitc_esp32c6_hpcore, esp32s3_devkitc_esp32s3_procpu
    - name: zephyr
      url: https://github.com/zephyrproject-rtos/zephyr
      revision: v4.4.0
      clone-depth: 1
      import:
        path-prefix: external
        name-allowlist:
          - hal_espressif    # Espressif (ESP32-C3, ESP32-C6, ESP32-S3)
          - mbedtls          # all boards
          - mcuboot          # all boards
          - zcbor            # all boards
          - mldsa-native     # all boards
          - tf-psa-crypto    # all boards

    - name: spotflow-device-sdk
      url: https://github.com/spotflow-io/device-sdk
      revision: main
      path: external/modules/lib/spotflow
```

## prj.conf
```kconfig
# ============================================
# Spotflow SDK
# ============================================
CONFIG_SPOTFLOW=y
CONFIG_SPOTFLOW_MODULE_DEFAULT_LOG_LEVEL=4

# ============================================
# Logging
# ============================================
CONFIG_LOG=y

# Zephyr log ring buffer (stage 1). Default 1024 B overflows during the early
# boot burst before the log thread gets a timeslice, causing dropped messages.
# See: https://docs.spotflow.io/best-practices/fixing-dropped-log-messages
CONFIG_LOG_BUFFER_SIZE=2048

CONFIG_LOG_RUNTIME_FILTERING=y
CONFIG_REQUIRES_FLOAT_PRINTF=y

# Show function names in log output, helps trace crashes to the exact call site.
CONFIG_LOG_FUNC_NAME_PREFIX_INF=y
CONFIG_LOG_FUNC_NAME_PREFIX_WRN=y
CONFIG_LOG_FUNC_NAME_PREFIX_ERR=y

# Spotflow backend queue (stage 2), independent of CONFIG_LOG_BUFFER_SIZE.
# QUEUE_SIZE: messages buffered during offline periods.
# LOG_BUFFER_SIZE: per-message staging buffer; size to your longest log line.
# See: https://docs.spotflow.io/best-practices/fixing-dropped-log-messages
CONFIG_SPOTFLOW_LOG_BACKEND_QUEUE_SIZE=16
CONFIG_SPOTFLOW_LOG_BUFFER_SIZE=256
CONFIG_SPOTFLOW_CBOR_LOG_MAX_LEN=512
CONFIG_HEAP_MEM_POOL_ADD_SIZE_SPOTFLOW_LOGGING=3072

# ============================================
# Metrics
# ============================================
CONFIG_SPOTFLOW_METRICS=y

# System metrics: heap, CPU, thread stacks, network I/O, reset cause, uptime heartbeat
CONFIG_SPOTFLOW_METRICS_SYSTEM=y
CONFIG_SPOTFLOW_METRICS_SYSTEM_RESET_CAUSE=y
CONFIG_SPOTFLOW_METRICS_HEARTBEAT=y
CONFIG_SPOTFLOW_METRICS_HEARTBEAT_INTERVAL=60

# ============================================
# Coredumps
# ============================================
CONFIG_SPOTFLOW_COREDUMPS=y

# Enable GPIO (used by the coredumps sample to trigger crashes via button)
CONFIG_GPIO=y

# Dump full RAM region (linker-defined) for AI-assisted crash analysis.
# DEBUG_COREDUMP_MEMORY_DUMP_THREADS is not supported on Xtensa; the
# linker-RAM dump is the correct setting for ESP32 and provides all the
# data Spotflow needs for AI root-cause analysis.
CONFIG_DEBUG_COREDUMP_MEMORY_DUMP_LINKER_RAM=y

CONFIG_DEBUG_COREDUMP_THREADS_METADATA=y

# ============================================
# Networking
# ============================================
CONFIG_NETWORKING=y
CONFIG_NET_MGMT=y
CONFIG_NET_MGMT_EVENT=y
CONFIG_NET_MGMT_EVENT_INFO=y
CONFIG_NET_CONFIG_AUTO_INIT=n
CONFIG_NET_CONNECTION_MANAGER=y
CONFIG_NET_DHCPV4=y
CONFIG_NET_IPV4=y
CONFIG_NET_IPV6=n
CONFIG_NET_TCP=y
CONFIG_NET_UDP=y

# ============================================
# Flash / Settings (required by Spotflow for state persistence)
# ============================================
CONFIG_FLASH=y
CONFIG_FLASH_MAP=y
CONFIG_NVS=y
CONFIG_SETTINGS=y
CONFIG_SETTINGS_NVS=y

# ============================================
# Stack / Heap
# ============================================
CONFIG_MAIN_STACK_SIZE=4096

# Ensures connection works on boards without hardware RNG.
# Remove this option for production use.
CONFIG_MBEDTLS_PSA_CRYPTO_LEGACY_RNG=y
```

## boards/esp32c3_devkitc.conf
```kconfig
# Automatic Wi-Fi reconnection
CONFIG_ESP32_WIFI_STA_RECONNECT=y

# ESP32-C3 DevKitC has limited flash — use minimal coredump format
CONFIG_DEBUG_COREDUMP_MEMORY_DUMP_MIN=y

# Reduce coredump memory footprint to fit within the smaller partition
CONFIG_HEAP_MEM_POOL_ADD_SIZE_SPOTFLOW_COREDUMPS=8192
CONFIG_SPOTFLOW_COREDUMPS_CHUNK_SIZE=1024
CONFIG_SPOTFLOW_COREDUMPS_BACKEND_QUEUE_SIZE=7
```

## boards/esp32_8M.dtsi
```dts
/* Redefining coredump partition to be 1MB at the end of 8MB flash, see:
 * zephyr/dts/common/espressif/partitions_0x0_default_4M.dtsi
 */

/delete-node/ &coredump_partition;

&flash0 {
	partitions {
		compatible = "fixed-partitions";
		#address-cells = <1>;
		#size-cells = <1>;

		/* New coredump partition: 1MB at the end of 8MB flash */
		coredump_partition: partition@700000 {
			label = "coredump-partition";
			reg = <0x700000 DT_SIZE_M(1)>;
		};
	};
};
```

## boards/esp32c3_devkitc.overlay
```dts
&wifi {
	status = "okay";
};

/* Remove the default scratch and coredump partitions, then define a
 * dedicated 128 KB coredump partition at the top of the 4 MB flash.
 * Based on partitions_0x0_default_4M.dtsi from Zephyr. */
/delete-node/ &scratch_partition;
/delete-node/ &coredump_partition;

&flash0 {
	partitions {
		compatible = "fixed-partitions";
		#address-cells = <1>;
		#size-cells = <1>;

		/* 128 KB coredump partition (124 KB from deleted scratch + 4 KB from old coredump) */
		coredump_partition: partition@3e0000 {
			label = "coredump-partition";
			reg = <0x3e0000 DT_SIZE_K(128)>;
		};
	};
};
```

## boards/esp32s3_devkitc_esp32s3_procpu.overlay
```dts
#include "esp32_8M.dtsi"

&wifi {
	status = "okay";
};
```

## src/main.c
```c
#include <zephyr/kernel.h>
#include <zephyr/drivers/gpio.h>
#include <zephyr/logging/log.h>

#include "metrics/spotflow_metrics_backend.h"

#include "net.h"
#include "sensor.h"

LOG_MODULE_REGISTER(industrial_sensor_main, LOG_LEVEL_INF);

/* ── Metric handles ─────────────────────────────────────────────────────── */
static struct spotflow_metric_float *g_temperature_metric;
static struct spotflow_metric_float *g_humidity_metric;
static struct spotflow_metric_int   *g_read_errors_metric;
static struct spotflow_metric_int   *g_crashes_metric;

/* ── Button / crash trigger ─────────────────────────────────────────────── */

/*
 * The BOOT button (sw0 alias) is used to simulate a use-after-free bug on
 * demand.  Pressing it frees the sensor handle while the polling thread still
 * holds a reference; the next sensor_read() call dereferences NULL, triggers
 * a Zephyr kernel panic, and Spotflow uploads the resulting coredump on the
 * next boot for AI-assisted analysis.
 *
 * In production firmware this class of bug typically appears when:
 *   - A watchdog or error-recovery path calls sensor_deinit() while the
 *     polling thread still holds a reference.
 *   - A task priority inversion causes the init/deinit sequence to race with
 *     the read loop.
 */
static const struct gpio_dt_spec g_button = GPIO_DT_SPEC_GET(DT_ALIAS(sw0), gpios);
static struct gpio_callback       g_button_cb;
static atomic_t                   g_crash_requested;

static void button_pressed_isr(const struct device *dev, struct gpio_callback *cb, uint32_t pins)
{
	ARG_UNUSED(dev);
	ARG_UNUSED(cb);
	ARG_UNUSED(pins);

	atomic_set(&g_crash_requested, 1);
	LOG_WRN("BOOT button pressed — crash will be triggered on next sensor read");
}

/* ── Forward declarations ───────────────────────────────────────────────── */
static int  init_sensor_metrics(void);
static void run_sensor_loop(sensor_handle_t *handle);

/* ── main ───────────────────────────────────────────────────────────────── */

int main(void)
{
	LOG_INF("ESP32 Industrial Sensor Node — Spotflow observability example");
	LOG_INF("Logs, metrics, and crash reports all enabled.");

	/* Allow the network interface driver to finish initialization. */
	k_sleep(K_SECONDS(1));

	/* Connect to Wi-Fi (or start DHCP on Ethernet, depending on board). */
	spotflow_sample_net_init();

	/* Register application metrics with Spotflow. */
	int rc = init_sensor_metrics();

	if (rc < 0) {
		LOG_ERR("Failed to initialize sensor metrics: %d", rc);
		return -1;
	}

	/* Initialize the I2C sensor. */
	sensor_handle_t *sensor = sensor_init();

	if (!sensor) {
		LOG_ERR("Sensor initialization failed — aborting");
		return -1;
	}

	/* Configure the BOOT button (sw0) to trigger a crash on press. */
	if (!gpio_is_ready_dt(&g_button)) {
		LOG_ERR("Button GPIO device not ready");
		return -1;
	}

	rc = gpio_pin_configure_dt(&g_button, GPIO_INPUT);
	if (rc < 0) {
		LOG_ERR("Failed to configure button pin: %d", rc);
		return -1;
	}

	/* Wait for strapping-pin glitch to settle before arming the interrupt.
	 * On ESP32-S3 the BOOT button is GPIO0, a strapping pin held low by
	 * the ROM bootloader during SPI_FAST_FLASH_BOOT.  Enabling the
	 * active-low edge interrupt too early fires a spurious ISR before the
	 * user touches anything.  100 ms is enough for the pin to float back
	 * high once the bootloader releases it. */
	k_sleep(K_MSEC(100));

	gpio_init_callback(&g_button_cb, button_pressed_isr, BIT(g_button.pin));
	gpio_add_callback(g_button.port, &g_button_cb);

	rc = gpio_pin_interrupt_configure_dt(&g_button, GPIO_INT_EDGE_TO_ACTIVE);
	if (rc < 0) {
		LOG_ERR("Failed to configure button interrupt: %d", rc);
		return -1;
	}

	LOG_INF("Press the BOOT button to trigger a use-after-free crash and coredump");
	LOG_INF("Starting sensor polling loop");

	run_sensor_loop(sensor);

	/* Never reached in normal operation — the loop ends with a crash. */
	return 0;
}

/* ── Sensor polling loop ────────────────────────────────────────────────── */

static void run_sensor_loop(sensor_handle_t *handle)
{
	sensor_reading_t reading;
	int read_count = 0;
	int consecutive_errors = 0;

	while (true) {
		int rc = sensor_read(handle, &reading);

		if (rc < 0) {
			consecutive_errors++;
			LOG_ERR("Sensor read failed (rc=%d, consecutive errors: %d)",
				rc, consecutive_errors);

			/* Report the error count metric so Spotflow alerting can
			 * fire if the error rate exceeds a threshold. */
			spotflow_report_metric_int(g_read_errors_metric, consecutive_errors);

			if (consecutive_errors >= 5) {
				LOG_ERR("Too many consecutive sensor errors — "
					"reporting crash metric and halting");
				spotflow_report_metric_int(g_crashes_metric, 1);
				k_sleep(K_FOREVER);
			}

			k_sleep(K_SECONDS(5));
			continue;
		}

		consecutive_errors = 0;
		read_count++;

		LOG_INF("Read #%d — temp: %.2f °C, humidity: %.2f %%",
			read_count, reading.temperature_c, reading.humidity_pct);

		/* Report sensor readings as immediate metrics (no aggregation)
		 * so Spotflow shows each individual value on the timeline. */
		spotflow_report_metric_float(g_temperature_metric, reading.temperature_c);
		spotflow_report_metric_float(g_humidity_metric, reading.humidity_pct);

		/* Periodic health log so the log stream shows the device is alive. */
		if (read_count % 10 == 0) {
			LOG_INF("Health check — %d reads completed, "
				"last temp: %.2f °C",
				read_count, reading.temperature_c);
		}

		/*
		 * If the BOOT button was pressed, simulate a use-after-free bug:
		 * free the sensor handle (as a buggy error-recovery path would)
		 * without clearing the pointer held by this thread.
		 *
		 * The warning is logged here — after the read succeeds and
		 * before the next k_sleep — so the log backend has time to
		 * upload it to Spotflow before the kernel panic that occurs at
		 * the start of the next loop iteration.
		 */
		if (atomic_cas(&g_crash_requested, 1, 0)) {
			LOG_WRN("Simulating sensor handle corruption "
				"(use-after-free in error recovery path)");
			sensor_deinit(handle);
			handle = NULL; /* pointer now dangling / NULL */
		}

		k_sleep(K_SECONDS(5));
	}
}

/* ── Metric registration ────────────────────────────────────────────────── */

static int init_sensor_metrics(void)
{
	int rc;

	/*
	 * Temperature — immediate float metric.
	 * Every individual reading is sent to Spotflow without aggregation,
	 * so the full time-series is visible in the dashboard.
	 */
	rc = spotflow_register_metric_float("sensor_temperature_celsius",
					    SPOTFLOW_AGG_INTERVAL_NONE,
					    &g_temperature_metric);
	if (rc < 0) {
		LOG_ERR("Failed to register temperature metric: %d", rc);
		return rc;
	}

	/*
	 * Humidity — immediate float metric.
	 */
	rc = spotflow_register_metric_float("sensor_humidity_percent",
					    SPOTFLOW_AGG_INTERVAL_NONE,
					    &g_humidity_metric);
	if (rc < 0) {
		LOG_ERR("Failed to register humidity metric: %d", rc);
		return rc;
	}

	/*
	 * Sensor read error counter — aggregated over 1 minute.
	 * An alert in the Spotflow dashboard fires when the sum of
	 * sensor_read_errors over a 5-minute window exceeds a threshold,
	 * giving the on-call engineer an early warning before the device
	 * crashes completely.
	 */
	rc = spotflow_register_metric_int("sensor_read_errors",
					  SPOTFLOW_AGG_INTERVAL_1MIN,
					  &g_read_errors_metric);
	if (rc < 0) {
		LOG_ERR("Failed to register read_errors metric: %d", rc);
		return rc;
	}

	/*
	 * Crash event counter — aggregated over 1 minute.
	 * Any non-zero value in the Spotflow dashboard means the device
	 * detected an unrecoverable error.  Combined with the coredump
	 * uploaded on the next boot, this metric pins the exact timestamp
	 * of the incident.
	 */
	rc = spotflow_register_metric_int("sensor_crashes",
					  SPOTFLOW_AGG_INTERVAL_1MIN,
					  &g_crashes_metric);
	if (rc < 0) {
		LOG_ERR("Failed to register crashes metric: %d", rc);
		return rc;
	}

	LOG_INF("Sensor metrics registered: temperature, humidity, "
		"read_errors, crashes");
	return 0;
}
```

## src/sensor.c
```c
#include "sensor.h"

#include <stdlib.h>
#include <zephyr/kernel.h>
#include <zephyr/logging/log.h>
#include <zephyr/random/random.h>

LOG_MODULE_REGISTER(sensor, LOG_LEVEL_DBG);

/*
 * Internal sensor state.  In a real driver this would hold the I2C device
 * pointer, calibration coefficients, etc.
 */
struct sensor_handle {
	/** Simulated I2C address of the sensor. */
	uint8_t i2c_addr;
	/** Sequence number — used to inject the crash after N reads. */
	uint32_t read_count;
};

sensor_handle_t *sensor_init(void)
{
	sensor_handle_t *h = k_malloc(sizeof(sensor_handle_t));

	if (!h) {
		LOG_ERR("Failed to allocate sensor handle");
		return NULL;
	}

	h->i2c_addr = 0x44; /* Simulated SHT4x address */
	h->read_count = 0;

	LOG_INF("Sensor initialized (I2C addr 0x%02x)", h->i2c_addr);
	return h;
}

int sensor_read(sensor_handle_t *handle, sensor_reading_t *out)
{
	/*
	 * Dereference `handle` unconditionally — if the caller passes NULL
	 * (which happens after sensor_deinit() in main.c), the CPU faults
	 * and Zephyr captures a coredump.
	 *
	 * A real driver would do `if (!handle) return -EINVAL;`, but we
	 * deliberately omit that guard to demonstrate the crash scenario.
	 */
	handle->read_count++;

	/* Simulate temperature: 18–30 °C with small random variation */
	uint32_t rand_temp = sys_rand32_get() % 1200; /* 0–11.99 */
	out->temperature_c = 18.0 + (double)rand_temp / 100.0;

	/* Simulate relative humidity: 40–70 % */
	uint32_t rand_hum = sys_rand32_get() % 3000; /* 0–29.99 */
	out->humidity_pct = 40.0 + (double)rand_hum / 100.0;

	LOG_DBG("Read %u: temp=%.2f°C hum=%.2f%%",
		handle->read_count, out->temperature_c, out->humidity_pct);

	return 0;
}

void sensor_deinit(sensor_handle_t *handle)
{
	if (!handle) {
		return;
	}

	LOG_INF("Deinitializing sensor (total reads: %u)", handle->read_count);
	k_free(handle);
}
```

## src/sensor.h
```c
#ifndef SENSOR_H
#define SENSOR_H

#include <stdint.h>

/**
 * @brief Opaque handle to a sensor instance.
 *
 * Obtained from sensor_init() and passed to every subsequent sensor call.
 * The handle becomes NULL after sensor_deinit() is called — any further use
 * triggers a fault that is captured as a Zephyr coredump and sent to Spotflow.
 */
typedef struct sensor_handle sensor_handle_t;

/**
 * @brief Sensor reading containing temperature and humidity.
 */
typedef struct {
	/** Temperature in degrees Celsius. */
	double temperature_c;
	/** Relative humidity in percent. */
	double humidity_pct;
} sensor_reading_t;

/**
 * @brief Initialize the (simulated) I2C sensor.
 *
 * @return Pointer to an allocated sensor handle, or NULL on failure.
 */
sensor_handle_t *sensor_init(void);

/**
 * @brief Read temperature and humidity from the sensor.
 *
 * @param handle  Sensor handle returned by sensor_init().
 *                Passing NULL causes a kernel panic — this is intentional in
 *                the example to demonstrate coredump capture.
 * @param out     Output reading populated on success.
 * @return        0 on success, negative errno on failure.
 */
int sensor_read(sensor_handle_t *handle, sensor_reading_t *out);

/**
 * @brief Release sensor resources.
 *
 * After this call the handle is freed. Callers must not use the handle again.
 *
 * @param handle  Sensor handle to release.
 */
void sensor_deinit(sensor_handle_t *handle);

#endif /* SENSOR_H */
```
