## CMakeLists.txt
```
cmake_minimum_required(VERSION 3.20.0)

if (EXISTS "${CMAKE_CURRENT_SOURCE_DIR}/credentials.conf")
    list(APPEND EXTRA_CONF_FILE "${CMAKE_CURRENT_SOURCE_DIR}/credentials.conf")
endif()

find_package(Zephyr REQUIRED HINTS $ENV{ZEPHYR_BASE})
project(zephyr_crash_debugging)

add_subdirectory(src/net ${CMAKE_CURRENT_BINARY_DIR}/src/net)

target_sources(app PRIVATE
        src/main.c
        src/sensor_node.c
)
```

## Kconfig
```
rsource "src/net/Kconfig"
source "Kconfig.zephyr"
```

## west.yml
```
manifest:
  projects:
    # Zephyr RTOS - FRDM-RW612 (NXP RW612)
    - name: zephyr
      url: https://github.com/zephyrproject-rtos/zephyr
      revision: v4.4.0
      clone-depth: 1
      import:
        path-prefix: external
        name-allowlist:
          - cmsis_6
          - hal_nxp
          - mbedtls
          - mcuboot
          - zcbor
          - mldsa-native
          - tf-psa-crypto
          - segger

    - name: spotflow-device-sdk
      url: https://github.com/spotflow-io/device-sdk
      revision: main
      path: external/modules/lib/spotflow
```

## prj.conf
```kconfig
# Spotflow SDK
CONFIG_SPOTFLOW=y
CONFIG_SPOTFLOW_MODULE_DEFAULT_LOG_LEVEL=4

# Logging
CONFIG_LOG=y
CONFIG_LOG_BUFFER_SIZE=2048
CONFIG_LOG_RUNTIME_FILTERING=y
CONFIG_REQUIRES_FLOAT_PRINTF=y
CONFIG_LOG_FUNC_NAME_PREFIX_INF=y
CONFIG_LOG_FUNC_NAME_PREFIX_WRN=y
CONFIG_LOG_FUNC_NAME_PREFIX_ERR=y
CONFIG_SPOTFLOW_LOG_BACKEND_QUEUE_SIZE=16
CONFIG_SPOTFLOW_LOG_BUFFER_SIZE=256
CONFIG_SPOTFLOW_CBOR_LOG_MAX_LEN=512
CONFIG_HEAP_MEM_POOL_ADD_SIZE_SPOTFLOW_LOGGING=3072

# Metrics
CONFIG_SPOTFLOW_METRICS=y
CONFIG_SPOTFLOW_METRICS_SYSTEM=y
CONFIG_SPOTFLOW_METRICS_SYSTEM_RESET_CAUSE=y
CONFIG_SPOTFLOW_METRICS_HEARTBEAT=y
CONFIG_SPOTFLOW_METRICS_HEARTBEAT_INTERVAL=60

# Coredumps
CONFIG_SPOTFLOW_COREDUMPS=y
CONFIG_GPIO=y
CONFIG_DEBUG_COREDUMP_MEMORY_DUMP_LINKER_RAM=y
CONFIG_DEBUG_COREDUMP_THREADS_METADATA=y

# Networking
CONFIG_NETWORKING=y
CONFIG_NET_MGMT=y
CONFIG_NET_MGMT_EVENT=y
CONFIG_NET_MGMT_EVENT_INFO=y
CONFIG_NET_CONFIG_AUTO_INIT=n
CONFIG_NET_CONNECTION_MANAGER=y
CONFIG_NET_DHCPV4=y
CONFIG_NET_IPV4=y
CONFIG_NET_IPV6=n
CONFIG_NET_TCP=y
CONFIG_NET_UDP=y

# Flash / Settings (required by Spotflow for state persistence)
CONFIG_FLASH=y
CONFIG_FLASH_MAP=y
CONFIG_NVS=y
CONFIG_SETTINGS=y
CONFIG_SETTINGS_NVS=y

# Stack / Heap
CONFIG_MAIN_STACK_SIZE=4096
CONFIG_HEAP_MEM_POOL_ADD_SIZE_SPOTFLOW_METRICS=6144
```

## credentials-sample.conf
```kconfig
# Copy this file to credentials.conf and fill in your values.
# credentials.conf is excluded from version control by .gitignore.
CONFIG_NET_WIFI_SSID=""
CONFIG_NET_WIFI_PASSWORD=""
CONFIG_SPOTFLOW_DEVICE_ID="zephyr-crash-debugging-001"
CONFIG_SPOTFLOW_INGEST_KEY=""
```

## boards/frdm_rw612.conf
```kconfig
# Fix buffer size for RW612 on Zephyr 4.1.0+
CONFIG_NET_BUF_DATA_SIZE=256

CONFIG_NXP_WIFI_SOFTAP_SUPPORT=n

# RTT log backend — lets us read logs via J-Link without a UART/CDC driver
CONFIG_USE_SEGGER_RTT=y
CONFIG_LOG_BACKEND_RTT=y
CONFIG_LOG_BACKEND_RTT_MODE_DROP=y
CONFIG_SEGGER_RTT_BUFFER_SIZE_UP=8192

# Log processing thread — needs extra stack for 3 backends (UART + RTT + Spotflow)
CONFIG_LOG_PROCESS_THREAD_STACK_SIZE=4096

# Coredump settings for FRDM-RW612
CONFIG_HEAP_MEM_POOL_ADD_SIZE_SPOTFLOW_COREDUMPS=8192
CONFIG_SPOTFLOW_COREDUMPS_CHUNK_SIZE=1024
CONFIG_SPOTFLOW_COREDUMPS_BACKEND_QUEUE_SIZE=16
```

## boards/frdm_rw612.overlay
```dts
/*
 * Reserve 2 MiB at the end of the W25Q512JV (64 MiB) flash for coredump storage.
 *
 * Original storage_partition starts at 0x620000 and spans the remainder of the
 * 64 MiB flash.  We shrink it by 2 MiB and place the coredump_partition in that
 * reclaimed space.
 *
 * Partition map after this overlay:
 *   boot_partition    0x00000000  128 KiB   (MCUboot, unchanged)
 *   slot0_partition   0x00020000    3 MiB   (application, unchanged)
 *   slot1_partition   0x00320000    3 MiB   (OTA slot, unchanged)
 *   storage_partition 0x00620000  ~55.9 MiB (NVS / settings)
 *   coredump_partition 0x03E00000   2 MiB   (Zephyr coredump backend)
 *
 * All offsets are aligned to the 4 KiB erase-block size of the W25Q512JV.
 */

/delete-node/ &storage_partition;

&w25q512jvfiq {
	partitions {
		storage_partition: partition@620000 {
			label = "storage";
			reg = <0x00620000 0x037E0000>;
		};

		coredump_partition: partition@3e00000 {
			label = "coredump-partition";
			reg = <0x03e00000 DT_SIZE_M(2)>;
		};
	};
};
```

## src/main.c
```c
#include <errno.h>

#include <zephyr/drivers/gpio.h>
#include <zephyr/kernel.h>
#include <zephyr/logging/log.h>

#include "net.h"
#include "sensor_node.h"

LOG_MODULE_REGISTER(main, LOG_LEVEL_INF);

#define SW0_NODE DT_ALIAS(sw0)
#if !DT_NODE_HAS_STATUS_OKAY(SW0_NODE)
#error "Unsupported board: sw0 devicetree alias is not defined"
#endif

static const struct gpio_dt_spec button = GPIO_DT_SPEC_GET_OR(SW0_NODE, gpios, { 0 });
static struct gpio_callback button_cb_data;

static void button_pressed(const struct device *dev, struct gpio_callback *cb, uint32_t pins)
{
	ARG_UNUSED(dev);
	ARG_UNUSED(cb);
	ARG_UNUSED(pins);

	LOG_WRN("User button pressed. Arming reproducible crash path.");
	sensor_node_trigger_repro_crash();
}

static int prepare_button(void)
{
	int ret;

	if (!gpio_is_ready_dt(&button)) {
		LOG_ERR("Error: button device %s is not ready", button.port->name);
		return -EINVAL;
	}

	ret = gpio_pin_configure_dt(&button, GPIO_INPUT);
	if (ret != 0) {
		LOG_ERR("Error %d: failed to configure %s pin %d",
			ret, button.port->name, button.pin);
		return ret;
	}

	ret = gpio_pin_interrupt_configure_dt(&button, GPIO_INT_EDGE_TO_ACTIVE);
	if (ret != 0) {
		LOG_ERR("Error %d: failed to configure interrupt on %s pin %d",
			ret, button.port->name, button.pin);
		return ret;
	}

	gpio_init_callback(&button_cb_data, button_pressed, BIT(button.pin));
	gpio_add_callback(button.port, &button_cb_data);

	return 0;
}

int main(void)
{
	LOG_INF("Zephyr crash debugging example starting");
	LOG_INF("This demo shows how Spotflow AI Crash Analysis identifies the root cause of a Zephyr RTOS crash.");

	int rc = prepare_button();
	if (rc != 0) {
		LOG_ERR("Failed to prepare button: %d", rc);
		return rc;
	}

	/* Allow the network interface driver to finish initialization. */
	k_sleep(K_SECONDS(1));
	spotflow_sample_net_init();

	rc = sensor_node_init();
	if (rc < 0) {
		LOG_ERR("Failed to initialize sensor node: %d", rc);
		return rc;
	}

	while (true) {
		sensor_node_step();
		k_sleep(K_SECONDS(2));
	}

	return 0;
}
```

## src/sensor_node.c
```c
#include "sensor_node.h"

#include <zephyr/kernel.h>
#include <zephyr/logging/log.h>
#include <zephyr/random/random.h>

#include "metrics/spotflow_metrics_backend.h"

LOG_MODULE_REGISTER(sensor_node, LOG_LEVEL_INF);

/* ---- application metrics ---- */
static struct spotflow_metric_float *g_temperature_metric;
static struct spotflow_metric_int   *g_read_errors_metric;

/* ---- crash path state ---- */

/*
 * Alert callback type.  In a real product this would be set during
 * initialization based on the device configuration (e.g. loaded from NVS or
 * provisioned from the cloud).  On this device variant the callback was never
 * registered because the node was provisioned as a sensor-only unit not wired
 * into an alerting backend.
 *
 * The firmware calls the callback unconditionally whenever the threshold is
 * exceeded: a classic null-function-pointer bug.
 */
typedef void (*alert_fn_t)(float temp_celsius);

static alert_fn_t g_alert_callback = NULL; /* not configured on this device */
static float      g_temp_threshold  = 40.0f; /* degrees C, safe under normal conditions */
static bool       g_repro_mode      = false;
static int        g_loop_count      = 0;

/* ---- helpers ---- */

static float rand_range(float min, float max)
{
	return min + ((float)(sys_rand32_get() % 1000) / 1000.0f) * (max - min);
}

/*
 * check_threshold: called every sensor cycle when repro mode is armed.
 *
 * BUG: g_alert_callback is NULL (alert handler not registered on this
 * device).  This models a real pattern: a callback is registered only on
 * certain device variants during initialization, but the processing path
 * calls it unconditionally, without a null check.
 */
static void check_threshold(float temp_celsius)
{
	if (temp_celsius > g_temp_threshold) {
		LOG_WRN("Temperature threshold exceeded: %.1f C (threshold: %.1f C)",
			(double)temp_celsius, (double)g_temp_threshold);
		/* NULL dereference: fatal fault on next line */
		g_alert_callback(temp_celsius);
	}
}

/* ---- public API ---- */

int sensor_node_init(void)
{
	int rc;

	g_loop_count = 0;
	g_repro_mode = false;

	rc = spotflow_register_metric_float(
		"temperature_celsius",
		SPOTFLOW_AGG_INTERVAL_NONE,
		&g_temperature_metric);
	if (rc < 0) {
		LOG_ERR("Failed to register temperature_celsius metric: %d", rc);
		return rc;
	}

	rc = spotflow_register_metric_int(
		"read_errors",
		SPOTFLOW_AGG_INTERVAL_NONE,
		&g_read_errors_metric);
	if (rc < 0) {
		LOG_ERR("Failed to register read_errors metric: %d", rc);
		return rc;
	}

	LOG_INF("Sensor node ready. Press the user button to reproduce the crash.");
	return 0;
}

void sensor_node_step(void)
{
	++g_loop_count;

	/* Simulate temperature in 28–34 °C range */
	float temp = rand_range(28.0f, 34.0f);

	int rc = spotflow_report_metric_float(g_temperature_metric, temp);
	if (rc < 0) {
		LOG_ERR("Failed to report temperature_celsius: %d", rc);
	}

	LOG_INF("Sensor reading: %.1f C", (double)temp);

	/* Simulate occasional I2C read errors (every 9th loop) */
	if ((g_loop_count % 9) == 0) {
		LOG_WRN("Sensor I2C read timeout, retrying");
		rc = spotflow_report_event(g_read_errors_metric);
		if (rc < 0) {
			LOG_ERR("Failed to report read_errors: %d", rc);
		}
	}

	/* Crash path: armed by button press */
	if (g_repro_mode && g_loop_count >= 3) {
		check_threshold(temp);
	}
}

void sensor_node_trigger_repro_crash(void)
{
	LOG_WRN("Crash path armed. Lowering temperature threshold to 20.0 C.");
	g_repro_mode     = true;
	g_loop_count     = 0;
	g_temp_threshold = 20.0f; /* below normal range, will trigger on next cycle */
}
```

## src/sensor_node.h
```c
#ifndef ZEPHYR_CRASH_DEBUGGING_SENSOR_NODE_H
#define ZEPHYR_CRASH_DEBUGGING_SENSOR_NODE_H

int  sensor_node_init(void);
void sensor_node_step(void);
void sensor_node_trigger_repro_crash(void);

#endif /* ZEPHYR_CRASH_DEBUGGING_SENSOR_NODE_H */
```
